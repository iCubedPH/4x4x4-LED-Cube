#define dataPin 5
#define latchPin 3
#define clockPin 4

unsigned long currentMillis = 0;
unsigned long previousMillis = 0;
int interval = 1;

const int pins = 7;
const int outputPins[pins] = {3, 4, 5, 9 , 10, 11, 12};
const int layerPins[4] = {9, 10, 11, 12};

byte patternStates[10] = {12, 8, 8, 12, 8, 8, 20, 18, 26, 56};
uint16_t data = 0;
int stateTime = 0;
byte iteration = 0, displayRefresh = 0, layer = 0, stateCounter = 0;
byte numOfPatterns = 10, currentPattern = 0;

uint16_t pattern_0_data[12][4] = {
  {0xEEC8, 0xEEC8, 0xEEC8, 0xEEC8},
  {0xFEC0, 0xFEC0, 0xFEC0, 0xFEC0},
  {0xFF00, 0xFF00, 0xFF00, 0xFF00},
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  {0xCCCC, 0xCCCC, 0xCCCC, 0xCCCC}
};
uint16_t pattern_1_data[8][4] = {
  {0xFFFF, 0x0000, 0x0000, 0x0000},
  {0xF99F, 0xF99F, 0x0000, 0x0000},
  {0x0000, 0xF99F, 0xF99F, 0x0000},
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  {0x0660, 0x0660, 0x0000, 0x0000}
};
uint16_t pattern_2_data[8][4] = {
  {0x33CC, 0x0000, 0x0000, 0xCC33},
  {0x33CC, 0X33CC, 0XCC33, 0XCC33},
  {0x33CC, 0xFFFF, 0xFFFF, 0xcc33},
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  {0x0000, 0x0000, 0x0000, 0x0000}
};
uint16_t pattern_3_data[12][4] = {
  {0x0000, 0x0000, 0x9009, 0x0000},
  {0x0000, 0x0000, 0x0000, 0x9009},
  {0x0000, 0x0000, 0x6FF6, 0x6FF6},
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  {0x0000, 0x0000, 0x0000, 0x9009}
};
uint16_t pattern_4_data[8][4] = {
  {0xCC33, 0x0000, 0x0000, 0x0000},
  {0x0000, 0x33CC, 0x0000, 0x0000},
  {0x0000, 0x0000, 0xCC33, 0x0000},
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  {0x33CC, 0x0000, 0x0000, 0x0000}
};

uint16_t pattern_5_data[8][4] = {
  {0xFFFF, 0x0FF0, 0x0FF0, 0x0000},
  {0xFFFF, 0x0FF0, 0x0FF0, 0x0000},
  {0xF000, 0xFFF0, 0xFFF0, 0xF000},
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  {0x000F, 0x0FFF, 0x0FFF, 0x000F}
};
uint16_t pattern_6_data[20][4] = {
  {0x0000, 0x0000, 0x0400, 0xFFFF},
  {0x0000, 0x0400, 0x0001, 0xFFFF},
  {0x0400, 0x0001, 0x0020, 0xFFFF},
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  {0xFFFF, 0xFFFF, 0xFFFF, 0xFFFF}
};
uint16_t pattern_7_data[18][4] = {
  {0x1000, 0x1000, 0x1000, 0x1000},
  {0x3000, 0x3000, 0x3000, 0x3000},
  {0x7000, 0x7000, 0x7000, 0x7000},
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  {0x0020, 0x0020, 0x0020, 0x0020}
};

uint16_t pattern_8_data[26][4] = {
  {0x0001, 0x0001, 0x0001, 0x0001},
  {0x0013, 0x0013, 0x0013, 0x0013},
  {0x0137, 0x0137, 0x0137, 0x0137},
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  {0x0000, 0x0000, 0x0000, 0x0001}
};
uint16_t pattern_9_data[56][4] = {
  {0x0000, 0x0000, 0x0000, 0x1000},
  {0x0000, 0x0000, 0x0000, 0x3000},
  {0x0000, 0x0000, 0x0000, 0x7000},
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  {0x0000, 0x0000, 0x0000, 0x0660}
};
void setup() {
  for (int x = 0; x < pins; x++) {
    pinMode(outputPins[x], OUTPUT);
  }
  digitalWrite(latchPin, LOW);
  shiftOut(dataPin, clockPin, MSBFIRST, 0);
  shiftOut(dataPin, clockPin, MSBFIRST, 0);
  digitalWrite(latchPin, HIGH);
}
void patternHandler() {
  stateCounter++;
  if (stateCounter >= patternStates[currentPattern]) {
    stateCounter = 0;
    iteration++;
    if (iteration >= 10) {
      currentPattern++;
      iteration = 0;
      if (currentPattern >= numOfPatterns) {
        currentPattern = 0;
      }
    }
  }
}
void display() {
  switch (currentPattern) {
    case 0 :
      data = pattern_0_data[stateCounter][layer];
      break;
    case 1:
      data = pattern_1_data[stateCounter][layer];
      break;
    case 2:
      data = pattern_2_data[stateCounter][layer];
      break;
    case 3:
      data = pattern_3_data[stateCounter][layer];
      break;
    case 4:
      data = pattern_4_data[stateCounter][layer];
      break;
    case 5:
      data = pattern_5_data[stateCounter][layer];
      break;
    case 6:
      data = pattern_6_data[stateCounter][layer];
      break;
    case 7:
      data = pattern_7_data[stateCounter][layer];
      break;
    case 8:
      data = pattern_8_data[stateCounter][layer];
      break;
    case 9:
      data = pattern_9_data[stateCounter][layer];
      break;
  }
  for (int x = 0; x < 4; x++) {
    digitalWrite(layerPins[x], LOW);
  }
  digitalWrite(latchPin, LOW);
  shiftOut(dataPin, clockPin, MSBFIRST, highByte(data));
  shiftOut(dataPin, clockPin, MSBFIRST, lowByte(data));
  digitalWrite(latchPin, HIGH);
  digitalWrite(layerPins[layer], HIGH);
  layer++;
  if (layer >= 4) {
    layer = 0;
  }
}
void loop() {
  currentMillis = millis();
  if (currentMillis - previousMillis >= interval) {
    previousMillis = currentMillis;
    stateTime++;
    displayRefresh++;
    if (displayRefresh >= 3) {
      displayRefresh = 0;
      display();
    }
    if (stateTime >= 100) {
      patternHandler();
      stateTime = 0;
    }
  }
}


